#include "main.h"


//PB12----RST
//PB13----DC
//PB14----D0
//PB15----D1

/*----RES-----PB12----*/
/*----D/C-----PB13----*/
/*----SCLK----PB14----*/
/*----SDIN----PB15----*/

#define LCD_RST_1  GPIO_SetBits(GPIOC,GPIO_Pin_0)
#define LCD_RST_0  GPIO_ResetBits(GPIOC,GPIO_Pin_0)

#define LCD_DC_1   GPIO_SetBits(GPIOC,GPIO_Pin_1)
#define LCD_DC_0   GPIO_ResetBits(GPIOC,GPIO_Pin_1)

#define LCD_SCL_1  GPIO_SetBits(GPIOC,GPIO_Pin_2)
#define LCD_SCL_0  GPIO_ResetBits(GPIOC,GPIO_Pin_2)

#define LCD_SDA_1  GPIO_SetBits(GPIOC,GPIO_Pin_3)
#define LCD_SDA_0  GPIO_ResetBits(GPIOC,GPIO_Pin_3)

const unsigned char F8X16[]=
{
  0x00,0x00,0x00,0x00,0x00,0x00,0x00,0x00,0x00,0x00,0x00,0x00,0x00,0x00,0x00,0x00,// 0
  0x00,0x00,0x00,0xF8,0x00,0x00,0x00,0x00,0x00,0x00,0x00,0x33,0x30,0x00,0x00,0x00,//!1
  0x00,0x10,0x0C,0x06,0x10,0x0C,0x06,0x00,0x00,0x00,0x00,0x00,0x00,0x00,0x00,0x00,//"2
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  0x00,0x06,0x01,0x01,0x02,0x02,0x04,0x04,0x00,0x00,0x00,0x00,0x00,0x00,0x00,0x00,//~94
};


void LCD_WrDat(unsigned char data)
{
	unsigned char i=8;
	LCD_DC_1;
    LCD_SCL_0;
    delay_us(1);
    while(i--)
     {
       if(data&0x80) LCD_SDA_1;
       else          LCD_SDA_0;
       LCD_SCL_1; 
       delay_us(1);         
       LCD_SCL_0;;    
       data<<=1;
     }
}

void LCD_WrCmd(unsigned char cmd)
{
	unsigned char i=8;
	LCD_DC_0;
    LCD_SCL_0;
    delay_us(1);
    while(i--)
     {
       if(cmd&0x80)	 LCD_SDA_1;
       else          LCD_SDA_0;
       LCD_SCL_1;
       delay_us(1);
       LCD_SCL_0;
       cmd<<=1;
     } 	
}

void LCD_Set_Pos(unsigned char x, unsigned char y)
{ 
  	LCD_WrCmd(0xb0+y);
  	LCD_WrCmd(((x&0xf0)>>4)|0x10);
  	LCD_WrCmd(x&0x0f); 
} 

void OLED_Clear(void)
{
	unsigned char y,x;	
	for(y=0;y<8;y++)
	{
		LCD_WrCmd(0xb0+y);
		LCD_WrCmd(0x01);
		LCD_WrCmd(0x10); 
		for(x=0;x<128;x++)
			LCD_WrDat(0);
	}
}

/***************************************************************/
void SetStartColumn(unsigned char d)
{
	LCD_WrCmd(0x00+d%16);   // Set Lower Column Start Address for Page Addressing Mode
						    // Default => 0x00
	LCD_WrCmd(0x10+d/16);   // Set Higher Column Start Address for Page Addressing Mode
						    // Default => 0x10
}
/***************************************************************/
void SetAddressingMode(unsigned char d)
{
	LCD_WrCmd(0x20);	// Set Memory Addressing Mode
	LCD_WrCmd(d);	    // Default => 0x02
						// 0x00 => Horizontal Addressing Mode
						// 0x01 => Vertical Addressing Mode
						// 0x02 => Page Addressing Mode
}
/***************************************************************/
void SetColumnAddress(unsigned char a, unsigned char b)
{
	LCD_WrCmd(0x21);	// Set Column Address
	LCD_WrCmd(a);	    // Default => 0x00 (Column Start Address)
	LCD_WrCmd(b);	    // Default => 0x7F (Column End Address)
}
/***************************************************************/
void SetPageAddress(unsigned char a, unsigned char b)
{
	LCD_WrCmd(0x22);	//Set Page Address
	LCD_WrCmd(a);		//Default => 0x00 (Page Start Address)
	LCD_WrCmd(b);	    //Default => 0x07 (Page End Address)
}
/***************************************************************/
void SetStartLine(unsigned char d)
{
	LCD_WrCmd(0x40|d);	// Set Display Start Line
						// Default => 0x40 (0x00)
}
/***************************************************************/
void SetContrastControl(unsigned char d)
{
	LCD_WrCmd(0x81);	//Set Contrast Control
	LCD_WrCmd(d);		//Default => 0x7F
}
/***************************************************************/
void Set_Charge_Pump(unsigned char d)
{
	LCD_WrCmd(0x8D);	//Set Charge Pump
	LCD_WrCmd(0x10|d);	//Default => 0x10
						//0x10 (0x00) => Disable Charge Pump
						//0x14 (0x04) => Enable Charge Pump
}
/***************************************************************/
void Set_Segment_Remap(unsigned char d)
{
	LCD_WrCmd(0xA0|d);  //Set Segment Re-Map
						//Default => 0xA0
						//0xA0 (0x00) => Column Address 0 Mapped to SEG0
						//0xA1 (0x01) => Column Address 0 Mapped to SEG127
}
/***************************************************************/
void Set_Entire_Display(unsigned char d)
{
	LCD_WrCmd(0xA4|d);  //Set Entire Display On / Off
						//Default => 0xA4
						//0xA4 (0x00) => Normal Display
						//0xA5 (0x01) => Entire Display On
}
/***************************************************************/
void Set_Inverse_Display(unsigned char d)
{
	LCD_WrCmd(0xA6|d);  //Set Inverse Display On/Off
						//Default => 0xA6
						//0xA6 (0x00) => Normal Display
						//0xA7 (0x01) => Inverse Display On
}
/***************************************************************/
void Set_Multiplex_Ratio(unsigned char d)
{
	LCD_WrCmd(0xA8);	//Set Multiplex Ratio
	LCD_WrCmd(d);	    //Default => 0x3F (1/64 Duty)
}
/***************************************************************/
void Set_Display_On_Off(unsigned char d)
{
	LCD_WrCmd(0xAE|d);  //Set Display On/Off
						//Default => 0xAE
						//0xAE (0x00) => Display Off
						//0xAF (0x01) => Display On
}
/***************************************************************/
void SetStartPage(unsigned char d)
{
	LCD_WrCmd(0xB0|d);	//Set Page Start Address for Page Addressing Mode
						//Default => 0xB0 (0x00)
}
/***************************************************************/
void Set_Common_Remap(unsigned char d)
{
	LCD_WrCmd(0xC0|d);	//Set COM Output Scan Direction
						//Default => 0xC0
						//0xC0 (0x00) => Scan from COM0 to 63
						//0xC8 (0x08) => Scan from COM63 to 0
}
/***************************************************************/
void Set_Display_Offset(unsigned char d)
{
	LCD_WrCmd(0xD3);    //Set Display Offset
	LCD_WrCmd(d);	    //Default => 0x00
}
/***************************************************************/
void Set_Display_Clock(unsigned char d)
{
	LCD_WrCmd(0xD5);	//Set Display Clock Divide Ratio / Oscillator Frequency
	LCD_WrCmd(d);	    //Default => 0x80
						//D[3:0] => Display Clock Divider
						//D[7:4] => Oscillator Frequency
}
/***************************************************************/
void Set_Precharge_Period(unsigned char d)
{
	LCD_WrCmd(0xD9);	//Set Pre-Charge Period
	LCD_WrCmd(d);		//Default => 0x22 (2 Display Clocks [Phase 2] / 2 Display Clocks [Phase 1])
						//D[3:0] => Phase 1 Period in 1~15 Display Clocks
						//D[7:4] => Phase 2 Period in 1~15 Display Clocks
}
/***************************************************************/
void Set_Common_Config(unsigned char d)
{
	LCD_WrCmd(0xDA);	//Set COM Pins Hardware Configuration
	LCD_WrCmd(0x02|d);	//Default => 0x12 (0x10)
						//Alternative COM Pin Configuration
						//Disable COM Left/Right Re-Map
}
/***************************************************************/
void Set_VCOMH(unsigned char d)
{
	LCD_WrCmd(0xDB);	//Set VCOMH Deselect Level
	LCD_WrCmd(d);	    //Default => 0x20 (0.77*VCC)
}
/***************************************************************/
void Set_NOP(void)
{
	LCD_WrCmd(0xE3);	// Command for No Operation
}

void LCD_P8x16Str(unsigned char x,unsigned char y,char ch[])
{
    char c=0,i=0,j=0;
    while (ch[j]!='\0')
     {
       c =ch[j]-32;
       if(x>120){x=0;y++;}
       LCD_Set_Pos(x,y);    
       for(i=0;i<8;i++)     
  	   LCD_WrDat(F8X16[c*16+i]);
       LCD_Set_Pos(x,y+1);    
  	   for(i=0;i<8;i++)     
  	   LCD_WrDat(F8X16[c*16+i+8]);  
  	   x+=8;
  	   j++;
     }
}

void OLED_Print(unsigned char x, unsigned char y, char ch[])
{
	char ch2[3];
	unsigned char ii=0;
	while(ch[ii] != '\0')
	{
			ch2[0] = ch[ii];
			ch2[1] = '\0';
			LCD_P8x16Str(x,y,ch2);
			x += 8;
			ii+= 1;
	}
}


/**
  * @brief  lcd_printf    12864?????
  * @param  void
  * @retval void
  */
void OLED_Printf(unsigned char x,unsigned char y,const char *fmt,...)
{
	static unsigned char last_len[4]={0,0,0,0};	
	static char LCD_BUF[128]={0}; 
	unsigned char len;
	unsigned char i;
	__va_list ap;
	
	va_start(ap,fmt);
	vsprintf((char *)LCD_BUF,fmt,ap);
	va_end(ap);
	
	len=strlen((char *)LCD_BUF)+2*y;
	for(i=len;i<last_len[x];i++)
	{
		LCD_BUF[i-2*y]=' ';
	}
	LCD_BUF[i-2*y]=0;
	OLED_Print(x,y,LCD_BUF);
	last_len[x]=len;
}

void OLED_Configuration(void)        
{
    GPIO_InitTypeDef gpio;
	
	RCC_AHB1PeriphClockCmd(RCC_AHB1Periph_GPIOC,ENABLE);

	gpio.GPIO_Pin = GPIO_Pin_0 | GPIO_Pin_1 | GPIO_Pin_2 | GPIO_Pin_3;
	gpio.GPIO_Mode = GPIO_Mode_OUT;
	gpio.GPIO_OType = GPIO_OType_PP;
	gpio.GPIO_Speed = GPIO_Speed_100MHz;
	GPIO_Init(GPIOC, &gpio);    

	LCD_SCL_1;
	LCD_RST_0;
	delay_ms(200);
	LCD_RST_1;

    Set_Display_On_Off(0x00);		// Display Off (0x00/0x01)
    Set_Display_Clock(0x80);		// Set Clock as 100 Frames/Sec
    Set_Multiplex_Ratio(0x3F);		// 1/64 Duty (0x0F~0x3F)
    Set_Display_Offset(0x00);		// Shift Mapping RAM Counter (0x00~0x3F)
    SetStartLine(0x00);			    // Set Mapping RAM Display Start Line (0x00~0x3F)
    Set_Charge_Pump(0x04);		    // Enable Embedded DC/DC Converter (0x00/0x04)
    SetAddressingMode(0x02);		// Set Page Addressing Mode (0x00/0x01/0x02)
    Set_Segment_Remap(0x01);		// Set SEG/Column Mapping     
    Set_Common_Remap(0x08);			// Set COM/Row Scan Direction 
    Set_Common_Config(0x10);		// Set Sequential Configuration (0x00/0x10)
    SetContrastControl(0xCF);	    // Set SEG Output Current
    Set_Precharge_Period(0xF1);		// Set Pre-Charge as 15 Clocks & Discharge as 1 Clock
    Set_VCOMH(0x40);			    // Set VCOM Deselect Level
    Set_Entire_Display(0x00);		// Disable Entire Display On (0x00/0x01)
    Set_Inverse_Display(0x00);		// Disable Inverse Display On (0x00/0x01)  
    Set_Display_On_Off(0x01);		// Display On (0x00/0x01)
    OLED_Clear();
	  LCD_Set_Pos(0,0);
}
