# file: Music.ioc
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Mcu.Family=STM32F4
Mcu.Name=STM32F427I(G-I)Hx
Mcu.Package=UFBGA176
NVIC.PriorityGroup=NVIC_PRIORITYGROUP_4
PH0/OSC_IN.Mode=HSE-External-Oscillator
PH0/OSC_IN.Signal=RCC_OSC_IN
PH1/OSC_OUT.Mode=HSE-External-Oscillator
PH1/OSC_OUT.Signal=RCC_OSC_OUT
PH6.Signal=S_TIM12_CH1
ProjectManager.HeapSize=0x200
ProjectManager.StackSize=0x400
ProjectManager.TargetToolchain=SW4STM32
RCC.48MHZClocksFreq_Value=84000000
RCC.AHBFreq_Value=168000000
RCC.APB1CLKDivider=RCC_HCLK_DIV4
RCC.APB1Freq_Value=42000000
RCC.APB1TimFreq_Value=84000000
RCC.APB2CLKDivider=RCC_HCLK_DIV2
RCC.APB2Freq_Value=84000000
RCC.APB2TimFreq_Value=168000000
RCC.CortexFreq_Value=168000000
RCC.HCLKFreq_Value=168000000
RCC.HSE_VALUE=12000000
RCC.HSI_VALUE=16000000
RCC.LSE_VALUE=32768
RCC.PLLM=6
RCC.PLLN=168
RCC.PLLSourceVirtual=RCC_PLLSOURCE_HSE
RCC.SYSCLKFreq_VALUE=168000000
RCC.SYSCLKSource=RCC_SYSCLKSOURCE_PLLCLK
RCC.VCOOutputFreq_Value=336000000
SH.S_TIM12_CH1.0=TIM12_CH1,PWM Generation1 CH1
TIM12.Channel-PWM\ Generation1\ CH1=TIM_CHANNEL_1
TIM12.Prescaler=83
VP_TIM12_VS_ClockSourceINT.Mode=Internal
board=custom

// file: Src/main.c
/* USER CODE BEGIN Header */
/**
  ******************************************************************************
  * @file           : main.c
  * @brief          : Main program body
  ******************************************************************************
  * @attention
  *
  * <h2><center>&copy; Copyright (c) 2020 STMicroelectronics.
  * All rights reserved.</center></h2>
  *
  * This software component is licensed by ST under BSD 3-Clause license,
  * the "License"; You may not use this file except in compliance with the
  * License. You may obtain a copy of the License at:
  *                        opensource.org/licenses/BSD-3-Clause
  *
  ******************************************************************************
  */
/* USER CODE END Header */

#include "main.h"

/* USER CODE BEGIN PTD */
typedef enum{
	Do1L = 262,     ///*261.63Hz*/    3822us
	Re2L = 294,     ///*293.66Hz*/    3405us
	Mi3L = 330,     ///*329.63Hz*/    3034us
	Fa4L = 349,     ///*349.23Hz*/    2863us
	So5L = 392,     ///*392.00Hz*/    2551us
	La6L = 440,     ///*440.00Hz*/    2272us
	Si7L = 494,     ///*493.88Hz*/    2052us

	Do1M = 523,     ///*523.25Hz*/    1911us
	Re2M = 587,     ///*587.33Hz*/    1703us
	Mi3M = 659,     ///*659.26Hz*/    1517us
	Fa4M = 698,     ///*698.46Hz*/    1432us
	So5M = 784,     ///*784.00Hz*/    1276us
	La6M = 880,     ///*880.00Hz*/    1136us
	Si7M = 988,     ///*987.77Hz*/    1012us

	Do1H = 1047,     ///*1046.50Hz*/   956us
	Re2H = 1175,     ///*1174.66Hz*/   851us
	Mi3H = 1319,     ///*1318.51Hz*/   758us
	Fa4H = 1397,     ///*1396.91Hz*/   716us
	So5H = 1568,     ///*1567.98Hz*/   638us
	La6H = 1760,     ///*1760.00Hz*/   568us
	Si7H = 1976,     ///*1975.53Hz*/   506us

	Silent  = 0,
	Finish  = -1
} buzzer_freq_t;

buzzer_freq_t littleStar_freq[] = {
		Do1M, Do1M, So5M, So5M, La6M, La6M, So5M, Silent,
		Fa4M, Fa4M, Mi3M, Mi3M, Re2M, Re2M, Do1M, Silent,
		So5M, So5M, Fa4M, Fa4M, Mi3M, Mi3M, Re2M, Silent,
		So5M, So5M, Fa4M, Fa4M, Mi3M, Mi3M, Re2M, Silent,
		Do1M, Do1M, So5M, So5M, La6M, La6M, So5M, Silent,
		Fa4M, Fa4M, Mi3M, Mi3M, Re2M, Re2M, Do1M, Silent,
		Finish
};

float littleStar_durt[] = {
		1, 1, 1, 1, 1, 1, 1, 1,
		1, 1, 1, 1, 1, 1, 1, 1,
		1, 1, 1, 1, 1, 1, 1, 1,
		1, 1, 1, 1, 1, 1, 1, 1,
		1, 1, 1, 1, 1, 1, 1, 1,
		1, 1, 1, 1, 1, 1, 1, 1,
		1
};

buzzer_freq_t War_Cant_of_Mars_Warhammer_40k_freq[] = {
		So5M, So5M, So5M, So5M, Fa4M, Mi3M, So5M, Do1H, Re2H,
		Mi3H, Mi3H, Mi3H, Re2H, Do1H, Do1H, Si7M,
		La6M, La6M, La6M, Si7M, Do1H, Si7M, Do1H, La6M,
		So5M, La6M, So5M, Mi3M, So5M, So5M, So5M,
		So5M, So5M, So5M, Fa4M, Mi3M, So5M, Do1H, Re2H,
		Mi3H, Mi3H, Mi3H, Re2H, Do1H, Do1H, Re2H, Re2H, Do1H, Si7M,
		Do1H, Silent, Silent, So5M, Fa4M, Mi3M, So5M, Do1H, Re2H,
		Mi3H, Do1H, Silent, La6M, Si7M, Do1H, Si7M, Do1H, La6M,
		So5M, Mi3M, Silent, So5M, Fa4M, Mi3M, So5M, Do1H, Re2H,
		Mi3H, Do1H, Do1H, Re2H, Re2H, Do1H, Si7M, Do1H, Silent, Silent,
		Finish
};

float War_Cant_of_Mars_Warhammer_40k_durt[] = {
		0.5, 0.25, 0.25, 0.5, 0.25, 0.5, 0.25, 0.5, 0.25,
		0.5, 0.25, 0.5, 0.25, 1, 0.5, 0.25,
		0.5, 0.25, 0.5, 0.25, 0.5, 0.25, 0.5, 0.25,
		0.5, 0.25, 0.5, 0.25, 1, 0.5, 0.25,
		0.5, 0.25, 0.5, 0.25, 0.5, 0.25, 0.5, 0.25,
		0.5, 0.25, 0.5, 0.25, 1, 1, 1, 1, 1, 1,
		2, 0.5, 0.5, 1, 0.5, 0.5, 0.25, 0.5, 0.25,
		2, 1, 0.5, 1, 0.5, 0.5, 0.25, 0.5, 0.25,
		2, 1, 0.5, 1, 0.5, 0.5, 0.25, 0.5, 0.25,
		2, 1, 1, 1, 1, 1, 1, 2, 1, 1,
		1
};
/* USER CODE END PTD */

TIM_HandleTypeDef htim12;

void SystemClock_Config(void);
static void MX_GPIO_Init(void);
static void MX_TIM12_Init(void);
/* USER CODE BEGIN PFP */
void buzzer_sing_tone(buzzer_freq_t freq);
void buzzer_sing_song(buzzer_freq_t *freq, float *durt);
/* USER CODE END PFP */

int main(void)
{

  /* MCU Configuration--------------------------------------------------------*/

  /* Reset of all peripherals, Initializes the Flash interface and the Systick. */
  HAL_Init();

  /* Configure the system clock */
  SystemClock_Config();

  /* Initialize all configured peripherals */
  MX_GPIO_Init();
  MX_TIM12_Init();
  /* USER CODE BEGIN 2 */
  HAL_TIM_PWM_Start(&htim12, TIM_CHANNEL_1);
  /* USER CODE END 2 */

  /* Infinite loop */
  /* USER CODE BEGIN WHILE */
  while (1)
  {
  	//buzzer_sing_song(littleStar_freq, littleStar_durt);
  	buzzer_sing_song(War_Cant_of_Mars_Warhammer_40k_freq, War_Cant_of_Mars_Warhammer_40k_durt);
    /* USER CODE END WHILE */

  }
}

void SystemClock_Config(void)
{
  RCC_OscInitTypeDef RCC_OscInitStruct = {0};
  RCC_ClkInitTypeDef RCC_ClkInitStruct = {0};

  /** Configure the main internal regulator output voltage
  */
  __HAL_RCC_PWR_CLK_ENABLE();
  __HAL_PWR_VOLTAGESCALING_CONFIG(PWR_REGULATOR_VOLTAGE_SCALE1);
  /** Initializes the CPU, AHB and APB busses clocks
  */
  RCC_OscInitStruct.OscillatorType = RCC_OSCILLATORTYPE_HSE;
  RCC_OscInitStruct.HSEState = RCC_HSE_ON;
  RCC_OscInitStruct.PLL.PLLState = RCC_PLL_ON;
  RCC_OscInitStruct.PLL.PLLSource = RCC_PLLSOURCE_HSE;
  RCC_OscInitStruct.PLL.PLLM = 6;
  RCC_OscInitStruct.PLL.PLLN = 168;
  RCC_OscInitStruct.PLL.PLLP = RCC_PLLP_DIV2;
  RCC_OscInitStruct.PLL.PLLQ = 4;
  if (HAL_RCC_OscConfig(&RCC_OscInitStruct) != HAL_OK)
  {
    Error_Handler();
  }
  /** Initializes the CPU, AHB and APB busses clocks
  */
  RCC_ClkInitStruct.ClockType = RCC_CLOCKTYPE_HCLK|RCC_CLOCKTYPE_SYSCLK
                              |RCC_CLOCKTYPE_PCLK1|RCC_CLOCKTYPE_PCLK2;
  RCC_ClkInitStruct.SYSCLKSource = RCC_SYSCLKSOURCE_PLLCLK;
  RCC_ClkInitStruct.AHBCLKDivider = RCC_SYSCLK_DIV1;
  RCC_ClkInitStruct.APB1CLKDivider = RCC_HCLK_DIV4;
  RCC_ClkInitStruct.APB2CLKDivider = RCC_HCLK_DIV2;

  if (HAL_RCC_ClockConfig(&RCC_ClkInitStruct, FLASH_LATENCY_5) != HAL_OK)
  {
    Error_Handler();
  }
}

static void MX_TIM12_Init(void)
{

  TIM_ClockConfigTypeDef sClockSourceConfig = {0};
  TIM_OC_InitTypeDef sConfigOC = {0};

  htim12.Instance = TIM12;
  htim12.Init.Prescaler = 83;
  htim12.Init.CounterMode = TIM_COUNTERMODE_UP;
  htim12.Init.Period = 0;
  htim12.Init.ClockDivision = TIM_CLOCKDIVISION_DIV1;
  htim12.Init.AutoReloadPreload = TIM_AUTORELOAD_PRELOAD_DISABLE;
  if (HAL_TIM_Base_Init(&htim12) != HAL_OK)
  {
    Error_Handler();
  }
  sClockSourceConfig.ClockSource = TIM_CLOCKSOURCE_INTERNAL;
  if (HAL_TIM_ConfigClockSource(&htim12, &sClockSourceConfig) != HAL_OK)
  {
    Error_Handler();
  }
  if (HAL_TIM_PWM_Init(&htim12) != HAL_OK)
  {
    Error_Handler();
  }
  sConfigOC.OCMode = TIM_OCMODE_PWM1;
  sConfigOC.Pulse = 0;
  sConfigOC.OCPolarity = TIM_OCPOLARITY_HIGH;
  sConfigOC.OCFastMode = TIM_OCFAST_DISABLE;
  if (HAL_TIM_PWM_ConfigChannel(&htim12, &sConfigOC, TIM_CHANNEL_1) != HAL_OK)
  {
    Error_Handler();
  }
  HAL_TIM_MspPostInit(&htim12);

}

static void MX_GPIO_Init(void)
{

  /* GPIO Ports Clock Enable */
  __HAL_RCC_GPIOH_CLK_ENABLE();

}

/* USER CODE BEGIN 4 */
void buzzer_sing_tone(buzzer_freq_t freq){
	__HAL_TIM_SET_AUTORELOAD(&htim12, 1e6 / freq);
	__HAL_TIM_SET_COMPARE(&htim12, TIM_CHANNEL_1, 1e6 / ( freq * 2 ));
}

void buzzer_sing_song(buzzer_freq_t *freq, float *durt){
	for(int i = 0; freq[i] != Finish; i++){
		buzzer_sing_tone(freq[i]);
		HAL_Delay(600 * durt[i]);
	}
	buzzer_sing_tone(Silent);
}
/* USER CODE END 4 */

void Error_Handler(void)
{
}

/************************ (C) COPYRIGHT STMicroelectronics *****END OF FILE****/
